## Kconfig
```kconfig
# Adafruit Feather nRF52840 Sense board configuration

# Copyright (c) 2020 Tobias Svehagen
# SPDX-License-Identifier: Apache-2.0

config BOARD_ENABLE_DCDC
	bool "DCDC mode"
	select SOC_DCDC_NRF52X
	default y
	depends on BOARD_ADAFRUIT_FEATHER_SENSE_NRF52840

config BOARD_SERIAL_BACKEND_CDC_ACM
	bool "USB CDC"
	default y
	
```

## Kconfig.board
```kconfig
# Adafruit Feather nRF52840 Sense board configuration

# Copyright (c) 2020 Tobias Svehagen
# SPDX-License-Identifier: Apache-2.0

config BOARD_ADAFRUIT_FEATHER_SENSE_NRF52840
	bool "Adafruit Feather nRF52840 Sense"
	depends on SOC_NRF52840_QIAA
```
